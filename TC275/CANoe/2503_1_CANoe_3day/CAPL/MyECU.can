/*@!Encoding:65001*/
includes
{
  
}

variables
{
  msTimer loop;
  int gCounter = 0;
}

on start
{
  setTimerCyclic(loop, 200);
}

on timer loop
{
  sendMsg();
}

void sendMsg() 
{
  message frmStatus msg;
  msg.sigCounter.phys = gCounter;
  gCounter++;
  
  if (gCounter > 255) {
    gCounter = 0;
  }
  output(msg);
}

on sysvar sysvar::My::btn
{ // 0 -> 1, 1 -> 0
  sendMsg();
  /*
  if (@sysvar::My::btn == 1) {
    message 0x1A1 msg;
    
    // 방법 1
    msg.sigCounter.phys = 13;
    output(msg);
    
    // 방법 2
    // msg.dlc = 4;
    // msg.byte(0) = 0x13;
    // msg.can = 1;
    // output(msg);
    
  }*/
}

